## main/Kconfig.projbuild
```kconfig
menu "Electronic load"

config LOAD_WIFI_DIAGNOSTIC_MODE
    bool "Start Wi-Fi AP without load hardware"
    default n
    help
        Skip I2C, INA219, PWM, buttons and display initialization so the
        access point can be checked on a bare ESP32 board.

endmenu
```

## sdkconfig.defaults
```kconfig
CONFIG_IDF_TARGET="esp32c3"
CONFIG_ESPTOOLPY_FLASHSIZE_4MB=y
CONFIG_PARTITION_TABLE_SINGLE_APP_LARGE=y
CONFIG_LV_FONT_MONTSERRAT_10=y
CONFIG_LV_FONT_MONTSERRAT_8=y
CONFIG_LV_FONT_UNSCII_8=y
```
